## board/autorock/rbctrl/Kconfig
```kconfig
if TARGET_RBCTRL

config SYS_CPU
	default "armv7"

config SYS_BOARD
	default "rbctrl"

config SYS_VENDOR
	default "autorock"

config SYS_SOC
	default "mx6"

config SYS_CONFIG_NAME
	default "rbctrl"

endif
```

## board/autorock/wisehmi/Kconfig
```kconfig
if TARGET_WISEHMI

config SYS_CPU
	default "armv7"

config SYS_BOARD
	default "wisehmi"

config SYS_VENDOR
	default "autorock"

config SYS_SOC
	default "mx6"

config SYS_CONFIG_NAME
	default "wisehmi"

endif
```

## configs/mx6dlrbctrl_defconfig
```kconfig
CONFIG_SYS_EXTRA_OPTIONS="IMX_CONFIG=board/autorock/rbctrl/mx6dl.cfg,MX6DL,BOOT_SPI,DDR_MB=1024"
CONFIG_TARGET_RBCTRL=y
CONFIG_ARM=y
```

## configs/mx6dlrbctrl_spl_defconfig
```kconfig
CONFIG_SPL=y
CONFIG_SYS_EXTRA_OPTIONS="IMX_CONFIG=board/autorock/rbctrl/mx6dl.cfg,MX6DL,BOOT_SPI,DDR_MB=1024"
+S:CONFIG_TARGET_RBCTRL=y
+S:CONFIG_ARM=y
```

## configs/mx6dlwisehmi_ddr128x16_mmc_spl_smp_defconfig
```kconfig
CONFIG_SPL=y
CONFIG_SYS_EXTRA_OPTIONS="IMX_CONFIG=board/autorock/wisehmi/mx6dl-ddr128x16.cfg,MX6DL,BOOT_MMC,SPL_SMP_BOOT,DDR_MB=256"
+S:CONFIG_ARM=y
```

## configs/mx6dlwisehmi_ddr128x32_mmc_spl_smp_defconfig
```kconfig
CONFIG_SPL=y
CONFIG_SYS_EXTRA_OPTIONS="IMX_CONFIG=board/autorock/wisehmi/mx6s.cfg,MX6DL,BOOT_MMC,SPL_SMP_BOOT,DDR_MB=512"
+S:CONFIG_ARM=y
```

## configs/mx6dlwisehmi_defconfig
```kconfig
CONFIG_SYS_EXTRA_OPTIONS="IMX_CONFIG=board/autorock/wisehmi/mx6dl.cfg,MX6DL"
CONFIG_ARM=y
CONFIG_TARGET_WISEHMI=y
```

## configs/mx6dlwisehmi_mmc_defconfig
```kconfig
CONFIG_SYS_EXTRA_OPTIONS="IMX_CONFIG=board/autorock/wisehmi/mx6dl.cfg,MX6DL,BOOT_MMC,DDR_MB=1024"
CONFIG_ARM=y
CONFIG_TARGET_WISEHMI=y
```

## configs/mx6dlwisehmi_mmc_spl_defconfig
```kconfig
CONFIG_SPL=y
CONFIG_SYS_EXTRA_OPTIONS="IMX_CONFIG=board/autorock/wisehmi/mx6dl.cfg,MX6DL,BOOT_MMC,DDR_MB=1024"
+S:CONFIG_ARM=y
```

## configs/mx6dlwisehmi_mmc_spl_smp_aes_defconfig
```kconfig
CONFIG_SPL=y
CONFIG_SYS_EXTRA_OPTIONS="IMX_CONFIG=board/autorock/wisehmi/mx6dl.cfg,MX6DL,BOOT_MMC,SPL_SMP_BOOT,DDR_MB=1024,AES_PACKIMG"
+S:CONFIG_ARM=y
```

## configs/mx6dlwisehmi_nand_defconfig
```kconfig
CONFIG_SYS_EXTRA_OPTIONS="IMX_CONFIG=board/autorock/wisehmi/mx6dl.cfg,MX6DL,BOOT_NAND,DDR_MB=1024"
CONFIG_ARM=y
CONFIG_TARGET_WISEHMI=y
```

## configs/mx6dlwisehmi_nand_spl_defconfig
```kconfig
CONFIG_SPL=y
CONFIG_SYS_EXTRA_OPTIONS="IMX_CONFIG=board/autorock/wisehmi/mx6dl.cfg,MX6DL,BOOT_NAND"
+S:CONFIG_ARM=y
```

## configs/mx6qwisehmi_mmc_defconfig
```kconfig
CONFIG_SYS_EXTRA_OPTIONS="IMX_CONFIG=board/autorock/wisehmi/mx6q.cfg,MX6Q,BOOT_MMC,DDR_MB=1024"
CONFIG_ARM=y
CONFIG_TARGET_WISEHMI=y
```

## configs/mx6qwisehmi_mmc_spl_defconfig
```kconfig
CONFIG_SPL=y
CONFIG_SYS_EXTRA_OPTIONS="IMX_CONFIG=board/autorock/wisehmi/mx6q.cfg,MX6Q,BOOT_MMC,DDR_MB=1024"
+S:CONFIG_ARM=y
```

## configs/mx6swisehmi_mmc_defconfig
```kconfig
CONFIG_SYS_EXTRA_OPTIONS="IMX_CONFIG=board/autorock/wisehmi/mx6s.cfg,MX6DL,BOOT_MMC,DDR_MB=512"
CONFIG_ARM=y
CONFIG_TARGET_WISEHMI=y
```
